## build/Kconfig/arch/Kconfig
```kconfig
# Load Zephyr Arch Kconfig descriptions.
osource "/home/amarjay/Desktop/code/first-zephyr/zephyr/arch/rx/Kconfig"
osource "/home/amarjay/Desktop/code/first-zephyr/zephyr/arch/x86/Kconfig"
osource "/home/amarjay/Desktop/code/first-zephyr/zephyr/arch/xtensa/Kconfig"
osource "/home/amarjay/Desktop/code/first-zephyr/zephyr/arch/sparc/Kconfig"
osource "/home/amarjay/Desktop/code/first-zephyr/zephyr/arch/riscv/Kconfig"
osource "/home/amarjay/Desktop/code/first-zephyr/zephyr/arch/posix/Kconfig"
osource "/home/amarjay/Desktop/code/first-zephyr/zephyr/arch/mips/Kconfig"
osource "/home/amarjay/Desktop/code/first-zephyr/zephyr/arch/arm64/Kconfig"
osource "/home/amarjay/Desktop/code/first-zephyr/zephyr/arch/arm/Kconfig"
osource "/home/amarjay/Desktop/code/first-zephyr/zephyr/arch/arc/Kconfig"
```

## build/Kconfig/boards/Kconfig
```kconfig
# Load Zephyr board Kconfig descriptions.
osource "/home/amarjay/Desktop/code/first-zephyr/zephyr/boards/espressif/esp32s3_devkitc/Kconfig"
```

## build/Kconfig/boards/Kconfig.defconfig
```kconfig
# Load Zephyr board defconfig descriptions.
osource "/home/amarjay/Desktop/code/first-zephyr/zephyr/boards/espressif/esp32s3_devkitc/Kconfig.defconfig"
```

## lib/simple_maths/Kconfig
```kconfig
# Kconfig for simple_maths library

config MATHS_LIB
	bool "Enable simple maths library"
	default n
	help
	Enable the simple_maths library and its API (add, subtract, multiply, divide).
```
